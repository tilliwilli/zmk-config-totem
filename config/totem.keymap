// ▄▄▄▄▄▄▄▄▄▄▄▄▄▄▄▄▄▄▄▄▄▄▄▄▄▄▄▄▄▄▄▄▄▄▄▄▄▄▄▄▄▄▄▄▄▄▄▄▄▄▄▄▄▄▄▄▄▄▄▄▄▄▄▄▄▄▄▄▄▄▄▄▄▄▄▄▄▄▄▄▄▄▄▄▄▄▄▄▄▄▄▄▄▄▄▄▄▄▄▄▄▄▄▄▄▄▄▄▄▄▄▄▄▄▄▄▄▄▄▄▄▄▄▄▄▄▄▄▄▄▄▄▄▄▄▄▄▄▄▄▄▄▄▄▄▄▄▄▄
//
//                                                        ▀▀▀▀▀     ▀▀▀▀▀          ▀▀█▀▀
//                                                        ▄▀▀▀▄  ▄  ▄▀▀▀▄  ▄  ▄▀▀▀▄  █  ▄▀▀▀▄
//                                                        █   █  █  █   █  █  █   █  █  █   █
//                                                         ▀▀▀   █   ▀▀▀   █   ▀▀▀   ▀   ▀▀▀
//                                                               █      ▄▄▄█▄▄▄    █   █
//                                                               ▀      █  █  █     █▄█
//                                                             ▀▀▀▀▀    █  █  █      ▀
//                                                                      ▀  ▀  ▀
//
// ▄▄▄▄▄▄▄▄▄▄▄▄▄▄▄▄▄▄▄▄▄▄▄▄▄▄▄▄▄▄▄▄▄▄▄▄▄▄▄▄▄▄▄▄▄▄▄▄▄▄▄▄▄▄▄▄▄▄▄▄▄▄▄▄▄▄▄▄▄▄▄▄▄▄▄▄▄▄▄▄▄▄▄▄▄▄▄▄▄▄▄▄▄▄▄▄▄▄▄▄▄▄▄▄▄▄▄▄▄▄▄▄▄▄▄▄▄▄▄▄▄▄▄▄▄▄▄▄▄▄▄▄▄▄▄▄▄▄▄▄▄▄▄▄▄▄▄▄▄


#include <behaviors.dtsi>
#include <dt-bindings/zmk/keys.h>
#include <dt-bindings/zmk/bt.h>
#include <dt-bindings/zmk/outputs.h>

#include "./zmk-helpers/totem.h"
#include "./zmk-helpers/helper.h"

/* Layers aliases */
#define L_DEF    0
#define L_QWERTY 1
#define L_SYM    2
#define L_NUMMEH 3
#define L_NUMFN  4
#define L_HYPER  5
#define L_MEDIA  6
#define L_NAVL   7
#define L_NAV    8

// #include "mouse.dtsi"

#define _X_ &none
#define ___ &trans

#define TAPPING_TERM 200
#define QUICK_TAP_MS 175
#define PRIOR_IDLE 100

/************************************************************************************/
// OOTB behavior configurations
/************************************************************************************/

&lt {  // regular layer-tap config
    flavor = "balanced";
    tapping-term-ms = <TAPPING_TERM>;
    quick-tap-ms = <QUICK_TAP_MS>;
};
ZMK_HOLD_TAP(ltw, // layer-tap w/o quick tap
    flavor = "balanced";
    tapping-term-ms = <TAPPING_TERM>;
    bindings = <&mo>, <&kp>;
)

&mt {  // mod-tap config
    flavor = "balanced";
    tapping-term-ms = <TAPPING_TERM>;
    quick-tap-ms = <QUICK_TAP_MS>;
};

&sk {  // sticky-key config
    release-after-ms = <900>;
    quick-release;             // no double capitalization when rolling keys
};

// layertap/modtap with sticky key instead of a normal keypress (and w/o quick tap, of course)
ZMK_HOLD_TAP(lt_sk,
    flavor = "balanced";
    tapping-term-ms = <TAPPING_TERM>;
    bindings = <&mo>, <&sk>;
)
ZMK_HOLD_TAP(mt_sk,
    flavor = "balanced";
    tapping-term-ms = <TAPPING_TERM>;
    bindings = <&kp>, <&sk>;
)

&sl {  // sticky-layer config
    ignore-modifiers;          // allow chording sticky mods & layers
};

/************************************************************************************/
// General macro behaviors
/************************************************************************************/

#define SIMPLE_MACRO(NAME, KEYPRESSES) \
    ZMK_MACRO(NAME, \
        bindings = <KEYPRESSES>; \
    )

// hold-tap with regular keypress on tap and a simple keypress macro on hold
#define MACROHOLD(NAME, MACROKEYPRESSES) \
    SIMPLE_MACRO(macrohold_macro_ ## NAME, MACROKEYPRESSES) \
    ZMK_HOLD_TAP(macrohold_ ## NAME, \
        flavor = "tap-preferred"; \
        tapping-term-ms = <TAPPING_TERM>; \
        bindings = <&macrohold_macro_ ## NAME>, <&kp>; \
    )

/************************************************************************************/
// Homerow mods
/************************************************************************************/

#define KEYS_L LT0 LT1 LT2 LT3 LT4 LM0 LM1 LM2 LM3 LM4 LB0 LB1 LB2 LB3 LB4 LB5  // left hand
#define KEYS_R RT0 RT1 RT2 RT3 RT4 RM0 RM1 RM2 RM3 RM4 RB0 RB1 RB2 RB3 RB4 RB5  // right hand
#define THUMBS LH2 LH1 LH0 RH0 RH1 RH2                                          // thumbs

#define MAKE_HRM(NAME, TRIGGER_POS) \
    ZMK_HOLD_TAP(NAME, \
        flavor = "balanced"; \
        tapping-term-ms = <280>; \
        quick-tap-ms = <QUICK_TAP_MS>; \
        require-prior-idle-ms = <PRIOR_IDLE>; \
        hold-trigger-key-positions = <TRIGGER_POS>; \
        hold-trigger-on-release; \
        bindings = <&kp>, <&kp>; \
    )

MAKE_HRM(hml, KEYS_R THUMBS)  // left-hand HRMs
MAKE_HRM(hmr, KEYS_L THUMBS)  // right-hand HRMs

/************************************************************************************/
// Smart layers: Caps-word, Num-word and Smart-mouse
/************************************************************************************/

//ZMK_MOD_MORPH(shift_nummeh,
//    mods = <(MOD_LSFT)>;
//    bindings = <&lt_sk L_NUMMEH LSFT>, <&mt_sk RSFT LSFT>;
//)

// &caps_word {
//    continue-list = <UNDERSCORE MINUS BACKSPACE DELETE LEFT RIGHT UP DOWN>;
// };


// tap: num-word | hold: num-layer
// num-word requires PR #1451

// #define SMART_NUM &smart_num NUM 0
// ZMK_HOLD_TAP(smart_num,
//     flavor = "balanced";
//     tapping-term-ms = <TAPPING_TERM>;
//     bindings = <&mo>, <&num_word>;
// )
// &num_word {
//     layers = <NUM>;
//     continue-list = <BSPC DEL DOT COMMA PLUS MINUS STAR FSLH EQUAL LPAR RPAR RIGHT LEFT F1 F2 F3 F4 F5 F6 F7 F8 F9 F10 F11 F12>;
//     ignore-modifiers;
// };

// using a regular tap/hold layer switch to the numbers layer in the meanwhile…
// ZMK_HOLD_TAP(mo_tog,
//     flavor = "balanced";
//     tapping-term-ms = <TAPPING_TERM>;
//     bindings = <&mo>, <&tog>;
// )
// #define MOTOG(LAYER) &mo_tog LAYER LAYER
// #define SMART_NUM MOTOG(NUM)


// smart-mouse, requires PR #1366
// ZMK_TRI_STATE(smart_mouse,
//     bindings = <&tog MOUSE>, <&none>, <&tog MOUSE>;
//     ignored-key-positions = <LT1 LT3 RT1 RT2 RT3 RM1 RM2 RM3 RH0 RH1>;
//     ignored-layers = <MOUSE>;
// )


// cancel caps-word, num-word and smart-mouse by sending a fake "cancel" key that does nothing, but is not whitelisted on any smart layer; also remove all layers
ZMK_MACRO(cancel_all,
    bindings = <&kp K_CANCEL &to L_DEF>;
)

/************************************************************************************/
// Misc. custom behaviors
/************************************************************************************/

// Alt+Tab swapper
ZMK_TRI_STATE(swapper,
    bindings = <&kt LGUI>, <&kp TAB>, <&kt LGUI>;
    ignored-key-positions = <LT2>;
)

// tap: comma | shift + tap: semicolon
ZMK_MOD_MORPH(comma_morph,
    mods = <(MOD_LSFT|MOD_RSFT)>;
    bindings = <&kp COMMA>, <&kp SEMICOLON>;
)

// tap: dot | shift + tap: colon
ZMK_MOD_MORPH(dot_morph,
    mods = <(MOD_LSFT|MOD_RSFT)>;
    bindings = <&kp DOT>, <&kp COLON>;
)

// SPACE with navigation layer on hold
// note: there is no quick-tap repeat on regular tap-hold to ease adding a space while navigating around (i.e. hopping in and out of the navigation layer)
// however, RSHIFT-Space (with right shift!) directly outputs a regular space keypress (without shift and with repeat) to easily add repeated spaces without needing to hammer the key
// left shift space (when tapped) outputs exactly that: shift-space
ZMK_MOD_MORPH(spc_nav,
    mods = <(MOD_RSFT)>;
    bindings = <&ltw L_NAV SPACE>, <&kp SPACE>;
)

// hold macros for some special symbols
MACROHOLD(excl, &kp SPACE &kp EXCL &kp EQUAL &kp SPACE)
#define EXCLHOLD &macrohold_excl 0 EXCL
MACROHOLD(equal, &kp SPACE &kp EQUAL &kp EQUAL &kp SPACE)
#define EQUALHOLD &macrohold_equal 0 EQUAL
MACROHOLD(amps, &kp SPACE &kp AMPS  &kp AMPS  &kp SPACE)
#define AMPSHOLD &macrohold_amps 0 AMPS
MACROHOLD(pipe, &kp SPACE &kp PIPE  &kp PIPE  &kp SPACE)
#define PIPEHOLD &macrohold_pipe 0 PIPE

/************************************************************************************/
// Hold-tap with single taps of (modified) keys on hold (no repeat on hold)
/************************************************************************************/

ZMK_MACRO_ONE_PARAM(simpletap,
    bindings = <&macro_param_1to1>, <&macro_tap &kp MACRO_PLACEHOLDER>;
)
ZMK_MACRO_ONE_PARAM(cmdtap,
    bindings = <&macro_press &kp LGUI>
             , <&macro_param_1to1>
             , <&macro_tap &kp MACRO_PLACEHOLDER>
             , <&macro_release &kp LGUI>;
)
ZMK_MACRO_ONE_PARAM(cmdsfttap,
    bindings = <&macro_press &kp LGUI &kp LSFT>
             , <&macro_param_1to1>
             , <&macro_tap &kp MACRO_PLACEHOLDER>
             , <&macro_release &kp LSFT &kp LGUI>;
)
ZMK_MACRO_ONE_PARAM(hypertap,
    bindings = <&macro_press &kp LGUI &kp LALT &kp LCTL &kp LSFT>
             , <&macro_param_1to1>
             , <&macro_tap &kp MACRO_PLACEHOLDER>
             , <&macro_release &kp LSFT &kp LCTL &kp LALT &kp LGUI>;
)

ZMK_HOLD_TAP(cmdhold,
    flavor = "tap-preferred";
    tapping-term-ms = <TAPPING_TERM>;
    bindings = <&cmdtap>, <&kp>;
)
ZMK_HOLD_TAP(cmdsfthold,
    flavor = "tap-preferred";
    tapping-term-ms = <TAPPING_TERM>;
    bindings = <&cmdsfttap>, <&kp>;
)
ZMK_HOLD_TAP(hyperhold,
    flavor = "tap-preferred";
    tapping-term-ms = <TAPPING_TERM>;
    bindings = <&hypertap>, <&kp>;
)

// tap: keypress | hold: CMD+keypress
#define ACMD(keycode)   &cmdhold keycode keycode
// tap: CMD+keypress | hold: CMD+SHIFT+keypress
#define ASCMD(keycode)  &cmdsfthold keycode LG(keycode)

// tap: CMD+G | hold: CMD+F
#define CMD_G_F      &cmdhold F LG(G)
// tap: CMD+SHFT+G | hold: CMD+SHFT+F
#define CMD_SFT_G_F  &cmdsfthold F LG(LS(G))

// tap: CTRL+SHIFT+TAB | hold: CMD+L
#define CMD_L_CSTAB  &cmdhold L LC(LS(TAB))
// tap: CTRL+TAB | hold: CMD+D
#define CMD_D_CTAB   &cmdhold D LC(TAB)


/************************************************************************************/
// Hyper/meh stuff
/************************************************************************************/

#define HYPER(keycode) LC(LA(LG(LS(keycode))))
#define MEH(keycode)   LC(LA(LG(keycode)))       // different from "regular" meh which does CTRL-ALT-SHIFT instead of CTRL-ALT-GUI
// hyper on hold, meh on tap
#define HYPERMEH(keycode) &hyperhold keycode MEH(keycode)

//ZMK_HOLD_TAP(hypercancel,
//    flavor = "tap-preferred";
//    tapping-term-ms = <TAPPING_TERM>;
//    bindings = <&kp>, <&cancel_all>;
//)
//#define HYPERCANCEL &hypercancel LC(LA(LS(LGUI))) 0

//#define HYPERBSPC &mt LC(LA(LS(LGUI))) BSPC

// activate a layer while also holding HYPER modifier(s)
ZMK_MACRO_ONE_PARAM(hypermo,
    wait-ms = <0>;
    tap-ms = <0>;
    bindings = <&macro_press &kp LGUI &kp LALT &kp LCTL &kp LSFT>
             , <&macro_param_1to1>
             , <&macro_press &mo MACRO_PLACEHOLDER>
             , <&macro_pause_for_release>
             , <&macro_param_1to1>
             , <&macro_release &mo MACRO_PLACEHOLDER>
             , <&macro_release &kp LSFT &kp LCTL &kp LALT &kp LGUI>;
)
ZMK_HOLD_TAP(hyperlt,
    flavor = "hold-preferred";
    tapping-term-ms = <TAPPING_TERM>;
    bindings = <&hypermo>, <&kp>;
)
#define HYPER_KP(keypress) &hyperlt L_HYPER keypress

// ▄▄▄▄▄▄▄▄▄▄▄▄▄▄▄▄▄▄▄▄▄▄▄▄▄▄▄▄▄▄▄▄▄▄▄▄▄▄▄▄▄▄▄▄▄▄▄▄▄▄▄▄▄▄▄▄▄▄▄▄▄▄▄▄▄▄▄▄▄▄▄▄▄▄▄▄▄▄▄▄▄▄▄▄▄▄▄▄▄▄▄▄▄▄▄▄▄▄▄▄▄▄▄▄▄▄▄▄▄▄▄▄▄▄▄▄▄▄▄▄▄▄▄▄▄▄▄▄▄▄▄▄▄▄▄▄▄▄▄▄▄▄▄▄▄▄▄▄▄
// COMBOS
// ▄▄▄▄▄▄▄▄▄▄▄▄▄▄▄▄▄▄▄▄▄▄▄▄▄▄▄▄▄▄▄▄▄▄▄▄▄▄▄▄▄▄▄▄▄▄▄▄▄▄▄▄▄▄▄▄▄▄▄▄▄▄▄▄▄▄▄▄▄▄▄▄▄▄▄▄▄▄▄▄▄▄▄▄▄▄▄▄▄▄▄▄▄▄▄▄▄▄▄▄▄▄▄▄▄▄▄▄▄▄▄▄▄▄▄▄▄▄▄▄▄▄▄▄▄▄▄▄▄▄▄▄▄▄▄▄▄▄▄▄▄▄▄▄▄▄▄▄▄

/*                KEY POSITIONS

  ╭─────────-───────────────╮ ╭─────────────────────────╮
  │     LT4 LT3 LT2 LT1 LT0 │ │ RT0 RT1 RT2 RT3 RT4     │
  │     LM4 LM3 LM2 LM1 LM0 │ │ RM0 RM1 RM2 RM3 RM4     │
  │ LB5 LB4 LB3 LB2 LB1 LB0 │ │ RB0 RB1 RB2 RB3 RB4 RB5 │
  ╰───────────╮ LH2 LH1 LH0 │ │ RH0 RH1 RH2 ╭───────────╯
              ╰─────────────╯ ╰─────────────╯ */

#define COMBO_TERM_FAST 30
#define COMBO_TERM_SLOW 40
#define COMBO_TERM_CROSSHAND 50

#define COMBO_LAYERS    L_DEF L_NUMMEH L_NUMFN L_NAV

/*********************************************************/
// Horizontal combos

// Left hand
ZMK_COMBO(lbrc   , &kp LEFT_BRACE,          LT3 LT2,     COMBO_LAYERS, COMBO_TERM_FAST, PRIOR_IDLE)
ZMK_COMBO(lpar   , &kp LEFT_PARENTHESIS,        LT2 LT1, COMBO_LAYERS, COMBO_TERM_FAST, PRIOR_IDLE)
ZMK_COMBO(at     , &kp AT_SIGN,             LT3 LT2 LT1, COMBO_LAYERS, COMBO_TERM_SLOW, PRIOR_IDLE)

ZMK_COMBO(tilde  , &kp TILDE,               LM3 LT2    , COMBO_LAYERS, COMBO_TERM_SLOW, PRIOR_IDLE)
ZMK_COMBO(caret  , &kp CARET,                   LT2 LM1, COMBO_LAYERS, COMBO_TERM_SLOW, PRIOR_IDLE)

ZMK_COMBO(sz     , &hml LA(LSFT) LA(S),     LM3 LM2,     COMBO_LAYERS, COMBO_TERM_FAST, PRIOR_IDLE)
ZMK_COMBO(bslh   , &hml LG(LSFT) BACKSLASH,     LM2 LM1, COMBO_LAYERS, COMBO_TERM_FAST, PRIOR_IDLE)
ZMK_COMBO(excl   , &hml LG(LA(LSFT)) EXCLAMATION, LM3 LM2 LM1, COMBO_LAYERS, COMBO_TERM_SLOW, PRIOR_IDLE)

ZMK_COMBO(grave  , &kp GRAVE,               LB3 LM2    , COMBO_LAYERS, COMBO_TERM_SLOW, PRIOR_IDLE)
ZMK_COMBO(hash   , &kp HASH,                    LM2 LB1, COMBO_LAYERS, COMBO_TERM_SLOW, PRIOR_IDLE)

ZMK_COMBO(lbkt   , &kp LEFT_BRACKET,        LB3 LB2,     COMBO_LAYERS, COMBO_TERM_FAST, PRIOR_IDLE)
ZMK_COMBO(lt     , &kp LESS_THAN,               LB2 LB1, COMBO_LAYERS, COMBO_TERM_FAST, PRIOR_IDLE)
ZMK_COMBO(prcnt  , &kp PERCENT,             LB3 LB2 LB1, COMBO_LAYERS, COMBO_TERM_SLOW, PRIOR_IDLE)

// Right hand
ZMK_COMBO(rpar   , &kp RIGHT_PARENTHESIS,   RT1 RT2,     COMBO_LAYERS, COMBO_TERM_FAST, PRIOR_IDLE)
ZMK_COMBO(rbrc   , &kp RIGHT_BRACE,             RT2 RT3, COMBO_LAYERS, COMBO_TERM_FAST, PRIOR_IDLE)
ZMK_COMBO(amps   , AMPSHOLD,                RT1 RT2 RT3, COMBO_LAYERS, COMBO_TERM_SLOW, PRIOR_IDLE)

ZMK_COMBO(dollar , &kp DOLLAR,              RM1 RT2,     COMBO_LAYERS, COMBO_TERM_SLOW, PRIOR_IDLE)
ZMK_COMBO(star   , &kp STAR,                    RT2 RM3, COMBO_LAYERS, COMBO_TERM_SLOW, PRIOR_IDLE)

ZMK_COMBO(minus  , &hmr RG(RSFT) MINUS,     RM1 RM2,     COMBO_LAYERS, COMBO_TERM_FAST, PRIOR_IDLE)
ZMK_COMBO(oe     , &hmr RA(RSFT) LA(O),         RM2 RM3, COMBO_LAYERS, COMBO_TERM_FAST, PRIOR_IDLE)
ZMK_COMBO(equal  , &hmr RG(RA(RSFT)) EQUAL, RM1 RM2 RM3, COMBO_LAYERS, COMBO_TERM_SLOW, PRIOR_IDLE)

ZMK_COMBO(under  , &kp UNDERSCORE,          RB1 RM2,     COMBO_LAYERS, COMBO_TERM_SLOW, PRIOR_IDLE)
ZMK_COMBO(plus   , &kp PLUS,                    RM2 RB3, COMBO_LAYERS, COMBO_TERM_SLOW, PRIOR_IDLE)

ZMK_COMBO(gt     , &kp GREATER_THAN,        RB1 RB2,     COMBO_LAYERS, COMBO_TERM_FAST, PRIOR_IDLE)
ZMK_COMBO(rbkt   , &kp RIGHT_BRACKET,           RB2 RB3, COMBO_LAYERS, COMBO_TERM_FAST, PRIOR_IDLE)
ZMK_COMBO(pipe   , PIPEHOLD,                RB1 RB2 RB3, COMBO_LAYERS, COMBO_TERM_SLOW, PRIOR_IDLE)

/*********************************************************/
// Vertical combos

/*********************************************************/
// Cross hand combos
//ZMK_COMBO(capsword, &caps_word,           LM2 RM2,     ALL, COMBO_TERM_CROSSHAND)

// ▄▄▄▄▄▄▄▄▄▄▄▄▄▄▄▄▄▄▄▄▄▄▄▄▄▄▄▄▄▄▄▄▄▄▄▄▄▄▄▄▄▄▄▄▄▄▄▄▄▄▄▄▄▄▄▄▄▄▄▄▄▄▄▄▄▄▄▄▄▄▄▄▄▄▄▄▄▄▄▄▄▄▄▄▄▄▄▄▄▄▄▄▄▄▄▄▄▄▄▄▄▄▄▄▄▄▄▄▄▄▄▄▄▄▄▄▄▄▄▄▄▄▄▄▄▄▄▄▄▄▄▄▄▄▄▄▄▄▄▄▄▄▄▄▄▄▄▄▄
// The actual keymap layers
// ▄▄▄▄▄▄▄▄▄▄▄▄▄▄▄▄▄▄▄▄▄▄▄▄▄▄▄▄▄▄▄▄▄▄▄▄▄▄▄▄▄▄▄▄▄▄▄▄▄▄▄▄▄▄▄▄▄▄▄▄▄▄▄▄▄▄▄▄▄▄▄▄▄▄▄▄▄▄▄▄▄▄▄▄▄▄▄▄▄▄▄▄▄▄▄▄▄▄▄▄▄▄▄▄▄▄▄▄▄▄▄▄▄▄▄▄▄▄▄▄▄▄▄▄▄▄▄▄▄▄▄▄▄▄▄▄▄▄▄▄▄▄▄▄▄▄▄▄▄

ZMK_LAYER(base,
//               ╭──────────────┬──────────────┬──────────────┬──────────────┬──────────────╮ ╭──────────────┬──────────────┬──────────────┬──────────────┬──────────────╮
                   &kp Q          &kp W          &kp L          &kp D          &kp P            &kp J          &kp M          &kp O          &kp Y          &kp SQT
//               ├──────────────┼──────────────┼──────────────┼──────────────┼──────────────┤ ├──────────────┼──────────────┼──────────────┼──────────────┼──────────────┤
                   &hml LCTL A    &hml LALT S    &hml LSFT R    &hml LGUI T    &kp G            &kp F          &hmr RGUI N    &hmr RSFT E    &hmr RALT I    &hmr RCTL U
//╭──────────────┼──────────────┼──────────────┼──────────────┼──────────────┼──────────────┤ ├──────────────┼──────────────┼──────────────┼──────────────┼──────────────┼──────────────╮
    &kp LA(A)      &lt L_NAVL X   &kp Z          &kp K          &kp C          &kp V            &kp B          &kp H          &comma_morph   &dot_morph     &lt L_NAV SLASH &lt L_MEDIA LA(U)
//╰──────────────┼──────────────┼──────────────┴──────────────┼──────────────┼──────────────┤ ├──────────────┼──────────────┼──────────────┼──────────────┴──────────────┴──────────────╯
                                                 HYPER_KP DEL   &lt L_NAV BSPC &lt L_NUMMEH ESC &lt L_NUMFN RET &mt RSFT SPACE &lt L_SYM TAB
//                                             ╰──────────────┴──────────────┴──────────────╯ ╰──────────────┴──────────────┴──────────────╯
)

ZMK_LAYER(qwerty,
//               ╭──────────────┬──────────────┬──────────────┬──────────────┬──────────────╮ ╭──────────────┬──────────────┬──────────────┬──────────────┬──────────────╮
                   &kp Q          &kp W          &kp E          &kp R          &kp T            &kp Y          &kp U          &kp I          &kp O          &kp P
//               ├──────────────┼──────────────┼──────────────┼──────────────┼──────────────┤ ├──────────────┼──────────────┼──────────────┼──────────────┼──────────────┤
                   &kp A          &kp S          &kp D          &kp F          &kp G            &kp H          &kp J          &kp K          &kp L          &kp SEMICOLON
//╭──────────────┼──────────────┼──────────────┼──────────────┼──────────────┼──────────────┤ ├──────────────┼──────────────┼──────────────┼──────────────┼──────────────┼──────────────╮
    &kp LSFT       &kp B          &kp Z          &kp X          &kp C          &kp V            &kp N          &kp M          &kp COMMA      &kp DOT        &kp FSLH       &kp RSFT
//╰──────────────┼──────────────┼──────────────┴──────────────┼──────────────┼──────────────┤ ├──────────────┼──────────────┼──────────────┼──────────────┴──────────────┴──────────────╯
                                                 &mt LCTL ESC   &kp SPACE      &kp TAB          &lt L_NUMFN BSPC &kp RET      &lt L_MEDIA DEL
//                                             ╰──────────────┴──────────────┴──────────────╯ ╰──────────────┴──────────────┴──────────────╯
)

ZMK_LAYER(symbols,
//               ╭──────────────┬──────────────┬──────────────┬──────────────┬──────────────╮ ╭──────────────┬──────────────┬──────────────┬──────────────┬──────────────╮
                   &kp TILDE      &kp EQUAL      &kp LBRC       &kp RBRC       &kp STAR         _X_            &kp CARET      &kp DOLLAR     &kp PERCENT    &kp SQT
//               ├──────────────┼──────────────┼──────────────┼──────────────┼──────────────┤ ├──────────────┼──────────────┼──────────────┼──────────────┼──────────────┤
                   &hml LCTL GRAVE &hml LALT MINUS &hml LSFT LPAR &hml LGUI RPAR &kp PLUS       _X_            &hmr RGUI EXCL &hmr RSFT AMPS &hmr RALT PIPE &hmr RCTL DQT
//╭──────────────┼──────────────┼──────────────┼──────────────┼──────────────┼──────────────┤ ├──────────────┼──────────────┼──────────────┼──────────────┼──────────────┼──────────────╮
	&kp AT_SIGN    &kp BSLH       &kp LT         &kp LBKT       &kp RBKT       &kp GT           _X_            _X_            &comma_morph   &dot_morph     &kp SLASH      &kp HASH
//╰──────────────┼──────────────┼──────────────┴──────────────┼──────────────┼──────────────┤ ├──────────────┼──────────────┼──────────────┼──────────────┴──────────────┴──────────────╯
                                                 ___            ___            ___              _X_            _X_            &mo L_SYM
//                                             ╰──────────────┴──────────────┴──────────────╯ ╰──────────────┴──────────────┴──────────────╯
)

ZMK_LAYER(numfn_meh,
//               ╭──────────────┬──────────────┬──────────────┬──────────────┬──────────────╮ ╭──────────────┬──────────────┬──────────────┬──────────────┬──────────────╮
                   &kp MEH(F12)   &kp MEH(W)     &kp LS(TAB)    &swapper       &kp MEH(P)       &kp F6         &kp F7         &kp F8         &kp F9         &kp F10
//               ├──────────────┼──────────────┼──────────────┼──────────────┼──────────────┤ ├──────────────┼──────────────┼──────────────┼──────────────┼──────────────┤
                   &mt LCTL MEH(A) &mt LALT MEH(S) &mt LSFT MEH(R) &mt LGUI MEH(T) &kp MEH(G)   &kp N6         &mt RGUI N7    &mt RSFT N8    &mt RALT N9    &mt RCTL N0
//╭──────────────┼──────────────┼──────────────┼──────────────┼──────────────┼──────────────┤ ├──────────────┼──────────────┼──────────────┼──────────────┼──────────────┼──────────────╮
    ASCMD(GRAVE)   &kp MEH(X)     &kp MEH(Z)     &kp MEH(K)     &kp MEH(C)     &kp MEH(V)       &kp F11        &kp F12        &comma_morph   &dot_morph     &kp SLASH      _X_
//╰──────────────┼──────────────┼──────────────┴──────────────┼──────────────┼──────────────┤ ├──────────────┼──────────────┼──────────────┼──────────────┴──────────────┴──────────────╯
                                                 _X_            &kp C_PP       &mo L_NUMMEH     ___            ___            ___
//                                             ╰──────────────┴──────────────┴──────────────╯ ╰──────────────┴──────────────┴──────────────╯
)

ZMK_LAYER(numfn_full,
//               ╭──────────────┬──────────────┬──────────────┬──────────────┬──────────────╮ ╭──────────────┬──────────────┬──────────────┬──────────────┬──────────────╮
                   &kp F1         &kp F2         &kp F3         &kp F4         &kp F5           &kp F6         &kp F7         &kp F8         &kp F9         &kp F10
//               ├──────────────┼──────────────┼──────────────┼──────────────┼──────────────┤ ├──────────────┼──────────────┼──────────────┼──────────────┼──────────────┤
                   &hml LCTL N1   &hml LALT N2   &hml LSFT N3   &hml LGUI N4   &kp N5           &kp N6         &hmr RGUI N7   &hmr RSFT N8   &hmr RALT N9   &hmr RCTL N0
//╭──────────────┼──────────────┼──────────────┼──────────────┼──────────────┼──────────────┤ ├──────────────┼──────────────┼──────────────┼──────────────┼──────────────┼──────────────╮
    _X_            &kp KP_SLASH   &kp KP_ASTERISK &kp KP_SUBTRACT &kp KP_PLUS  _X_              &kp F11        &kp F12        &comma_morph   &dot_morph     &kp SLASH      _X_
//╰──────────────┼──────────────┼──────────────┴──────────────┼──────────────┼──────────────┤ ├──────────────┼──────────────┼──────────────┼──────────────┴──────────────┴──────────────╯
                                                 ___            ___            ___              &mo L_NUMFN    &kp C_PP       _X_
//                                             ╰──────────────┴──────────────┴──────────────╯ ╰──────────────┴──────────────┴──────────────╯
)

ZMK_LAYER(hyper,
//               ╭──────────────┬──────────────┬──────────────┬──────────────┬──────────────╮ ╭──────────────┬──────────────┬──────────────┬──────────────┬──────────────╮
                   &kp F12        ___            ___            ___            ___              ___            ___            ___            ___            &kp F3
//               ├──────────────┼──────────────┼──────────────┼──────────────┼──────────────┤ ├──────────────┼──────────────┼──────────────┼──────────────┼──────────────┤
                   ___            ___            ___            ___            ___              ___            ___            ___            ___            ___
//╭──────────────┼──────────────┼──────────────┼──────────────┼──────────────┼──────────────┤ ├──────────────┼──────────────┼──────────────┼──────────────┼──────────────┼──────────────╮
    &kp F11        ___            ___            ___            ___            ___              ___            ___            &kp F7         &kp F6         &kp F5         &kp F4
//╰──────────────┼──────────────┼──────────────┴──────────────┼──────────────┼──────────────┤ ├──────────────┼──────────────┼──────────────┼──────────────┴──────────────┴──────────────╯
                                                 &mo L_HYPER    _X_            _X_              &kp F10        &kp F9         &kp F8
//                                             ╰──────────────┴──────────────┴──────────────╯ ╰──────────────┴──────────────┴──────────────╯
)

ZMK_LAYER(media,
//               ╭──────────────┬──────────────┬──────────────┬──────────────┬──────────────╮ ╭──────────────┬──────────────┬──────────────┬──────────────┬──────────────╮
                   _X_            &bt BT_SEL 2   &bt BT_SEL 1   &bt BT_SEL 0   &bt BT_CLR       _X_            _X_            &kp C_VOL_UP   _X_            _X_
//               ├──────────────┼──────────────┼──────────────┼──────────────┼──────────────┤ ├──────────────┼──────────────┼──────────────┼──────────────┼──────────────┤
                   &kp LCTL       &kp LALT       &kp LSFT       &kp LGUI       _X_              &kp C_BRI_UP   &kp C_PREV     &kp C_VOL_DN   &kp C_NEXT     _X_
//╭──────────────┼──────────────┼──────────────┼──────────────┼──────────────┼──────────────┤ ├──────────────┼──────────────┼──────────────┼──────────────┼──────────────┼──────────────╮
    _X_            _X_            _X_            _X_            _X_            _X_              &kp C_BRI_DN   &kp C_BRI_DN   &kp C_MUTE     &kp C_BRI_UP   _X_            &mo L_MEDIA
//╰──────────────┼──────────────┼──────────────┴──────────────┼──────────────┼──────────────┤ ├──────────────┼──────────────┼──────────────┼──────────────┴──────────────┴──────────────╯
                                                 _X_            _X_            _X_              &tog L_QWERTY  _X_            &mo L_MEDIA
//                                             ╰──────────────┴──────────────┴──────────────╯ ╰──────────────┴──────────────┴──────────────╯
)

ZMK_LAYER(navigation_left,
//               ╭──────────────┬──────────────┬──────────────┬──────────────┬──────────────╮ ╭──────────────┬──────────────┬──────────────┬──────────────┬──────────────╮
                   _X_            &kp BSPC       &kp UP         &kp DEL        _X_              _X_            _X_            _X_            _X_            _X_
//               ├──────────────┼──────────────┼──────────────┼──────────────┼──────────────┤ ├──────────────┼──────────────┼──────────────┼──────────────┼──────────────┤
                   _X_            &kp LEFT       &kp DOWN       &kp RIGHT      &kp PG_UP        _X_            _X_            _X_            _X_            _X_
//╭──────────────┼──────────────┼──────────────┼──────────────┼──────────────┼──────────────┤ ├──────────────┼──────────────┼──────────────┼──────────────┼──────────────┼──────────────╮
    _X_            &mo L_NAVL     &kp HOME       _X_            &kp END        &kp PG_DN        _X_            _X_            _X_            _X_            _X_            _X_
//╰──────────────┼──────────────┼──────────────┴──────────────┼──────────────┼──────────────┤ ├──────────────┼──────────────┼──────────────┼──────────────┴──────────────┴──────────────╯
                                                 &kp TAB        &kp SPACE      &kp RET          _X_            _X_            _X_
//                                             ╰──────────────┴──────────────┴──────────────╯ ╰──────────────┴──────────────┴──────────────╯
)

ZMK_LAYER(navigation,
//               ╭──────────────┬──────────────┬──────────────┬──────────────┬──────────────╮ ╭──────────────┬──────────────┬──────────────┬──────────────┬──────────────╮
                   &kp LG(Q)      &kp LG(W)      CMD_L_CSTAB    CMD_D_CTAB     CMD_SFT_G_F      _X_            &kp BSPC       &kp UP         &kp DEL        _X_
//               ├──────────────┼──────────────┼──────────────┼──────────────┼──────────────┤ ├──────────────┼──────────────┼──────────────┼──────────────┼──────────────┤
                   &mt LCTL LG(A) &mt LALT LG(S) &mt LSFT LG(R) &mt LGUI LG(T) CMD_G_F          &kp PG_UP      &kp LEFT       &kp DOWN       &kp RIGHT      _X_
//╭──────────────┼──────────────┼──────────────┼──────────────┼──────────────┼──────────────┤ ├──────────────┼──────────────┼──────────────┼──────────────┼──────────────┼──────────────╮
    &kp LG(LBKT)   &kp LG(X)      &kp LG(Z)      &kp LG(K)      &kp LG(C)      &kp LG(V)        &kp PG_DN      &kp HOME       _X_            &kp END        &mo L_NAV      &kp LG(RBKT)
//╰──────────────┼──────────────┼──────────────┴──────────────┼──────────────┼──────────────┤ ├──────────────┼──────────────┼──────────────┼──────────────┴──────────────┴──────────────╯
                                                 _X_            &mo L_NAV      _X_              &kp RET        &kp SPACE      &kp TAB
//                                             ╰──────────────┴──────────────┴──────────────╯ ╰──────────────┴──────────────┴──────────────╯
)

/*
ZMK_LAYER(template,
//               ╭──────────────┬──────────────┬──────────────┬──────────────┬──────────────╮ ╭──────────────┬──────────────┬──────────────┬──────────────┬──────────────╮
                   _X_            _X_            _X_            _X_            _X_              _X_            _X_            _X_            _X_            _X_
//               ├──────────────┼──────────────┼──────────────┼──────────────┼──────────────┤ ├──────────────┼──────────────┼──────────────┼──────────────┼──────────────┤
                   _X_            _X_            _X_            _X_            _X_              _X_            _X_            _X_            _X_            _X_
//╭──────────────┼──────────────┼──────────────┼──────────────┼──────────────┼──────────────┤ ├──────────────┼──────────────┼──────────────┼──────────────┼──────────────┼──────────────╮
    _X_            _X_            _X_            _X_            _X_            _X_              _X_            _X_            _X_            _X_            _X_            _X_
//╰──────────────┼──────────────┼──────────────┴──────────────┼──────────────┼──────────────┤ ├──────────────┼──────────────┼──────────────┼──────────────┴──────────────┴──────────────╯
                                                 _X_            _X_            _X_              _X_            _X_            _X_
//                                             ╰──────────────┴──────────────┴──────────────╯ ╰──────────────┴──────────────┴──────────────╯
)
*/
// vim: nowrap
